## libraries/lvgl/Kconfig
```kconfig
# Kconfig file for package LVGL
menuconfig PKG_USING_LVGL_DEMOS
    bool "LVGL-DEMOS (official): powerful and easy-to-use embedded GUI library demos"
    default n

if PKG_USING_LVGL_DEMOS
    config PKG_LVGL_DEMOS_PATH
        string
        default "/packages/multimedia/LVGL-DEMOS/"

    config LVGL_USING_DEMO_BENCHMARK
        bool "A demo to measure the performance of LVGL or to compare different settings"
        default n

    config LVGL_USING_DEMO_KEYPAD_ENCODER
        bool "LVGL allows you to control the widgets with a keypad and/or encoder without a touchpad"
        default n

    config LVGL_USING_DEMO_MUSIC
        bool "The music player demo shows what kind of modern, smartphone-like user interfaces can be created on LVGL"
        default n

    config LVGL_USING_DEMO_STRESS
        bool "A stress test for LVGL. It contains a lot of object creation, deletion, animations, style usage, and so on"
        default n

    config LVGL_USING_DEMO_WIDGETS
        bool "Shows how the widgets look like out of the box using the built-in material theme"
        default n
endif
```
